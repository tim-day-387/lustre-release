## libcfs/Kconfig
```kconfig
# SPDX-License-Identifier: GPL-2.0

#
# This file is part of Lustre, http://www.lustre.org/
#

config LIBCFS
	tristate "Lustre common library (libcfs)"
	help
	  libcfs is a foundational library shared by Lustre and LNet. It
	  provides portable utilities, debug and tracing infrastructure,
	  and compatibility shims used by the rest of the Lustre stack.

	  LIBCFS is required by LNet and Lustre and is normally selected
	  automatically when either is enabled.

	  To compile as modules, choose M here.

	  If unsure, say N.
```

## lnet/Kconfig
```kconfig
# SPDX-License-Identifier: GPL-2.0

#
# This file is part of Lustre, http://www.lustre.org/
#

config LNET
	tristate "Lustre networking (LNet) support"
	depends on NET
	help
	  LNet is the Lustre networking subsystem. It provides a reliable,
	  high-performance messaging layer that supports multiple underlying
	  network transports (InfiniBand, TCP, etc.).

	  LNet is required by the Lustre filesystem.

	  To compile as modules, choose M here.

	  If unsure, say N.

if LNET

config LNET_O2IBLND
	bool "LNet InfiniBand (o2iblnd) driver"
	depends on INFINIBAND
	help
	  Enable the InfiniBand LNet network driver (o2iblnd).

	  If unsure, say N.

config LNET_GNILND
	bool "LNet Gemini/Aries (gnilnd) driver"
	help
	  Enable the Cray Gemini/Aries interconnect LNet network driver.

	  If unsure, say N.

config LNET_KFILND
	bool "LNet libfabric (kfilnd) driver"
	help
	  Enable the kernel libfabric LNet network driver.

	  If unsure, say N.

config LNET_EFALND
	bool "LNet EFA (efalnd) driver"
	help
	  Enable the AWS Elastic Fabric Adapter LNet network driver.

	  If unsure, say N.

endif # LNET
```

## lustre/Kconfig
```kconfig
# SPDX-License-Identifier: GPL-2.0

#
# This file is part of Lustre, http://www.lustre.org/
#

config LUSTRE
	tristate "Lustre filesystem support"
	depends on LNET
	help
	  Lustre is a high-performance, scalable parallel filesystem
	  commonly used in supercomputing and large-scale cluster
	  environments.

	  To compile as modules, choose M here.

	  If unsure, say N.

if LUSTRE

config LUSTRE_FS
	bool "Lustre client support"
	default y
	help
	  Enable Lustre client support. This allows mounting Lustre
	  filesystems.

	  If unsure, say Y.

config LUSTRE_FS_SERVER
	bool "Lustre server support"
	default y
	help
	  Enable Lustre server support (MDS, OSS, MGS).

	  If unsure, say N.

config LUSTRE_FS_LDISKFS
	bool "Lustre ldiskfs OSD support"
	depends on LUSTRE_FS_SERVER
	depends on LDISKFS_FS || EXT4_FS
	help
	  Enable the ldiskfs (ext4-based) Object Storage Device backend
	  for Lustre servers.

	  If unsure, say N.

config LUSTRE_FS_ZFS
	bool "Lustre ZFS OSD support"
	default y
	depends on LUSTRE_FS_SERVER
	depends on ZFS
	help
	  Enable the ZFS Object Storage Device backend for Lustre servers.

	  If unsure, say N.

config LUSTRE_FS_GSS
	bool "Lustre GSS security support"
	default n
	depends on CRYPTO
	help
	  Enable GSS (Generic Security Services) support for Lustre,
	  providing Kerberos authentication and encryption.

	  If unsure, say N.

config LUSTRE_FS_GSS_SSK
	bool "Lustre GSS shared-secret key support"
	default n
	depends on LUSTRE_FS_GSS
	help
	  Enable shared-secret key (SSK) mechanism for Lustre GSS.

	  If unsure, say N.

config LUSTRE_FS_GSS_KEYRING
	bool "Lustre GSS keyring support"
	default n
	depends on LUSTRE_FS_GSS
	depends on KEYS
	help
	  Enable kernel keyring integration for Lustre GSS.

	  If unsure, say N.

config LUSTRE_FS_TESTS
	bool "Lustre kernel unit tests"
	default n
	help
	  Build Lustre in-kernel unit tests.

	  If unsure, say N.

endif # LUSTRE
```
